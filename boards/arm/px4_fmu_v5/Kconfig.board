## boards/arm/px4_fmu_v5/Kconfig.board
```kconfig
# Kconfig - PX4_FMU_V5 board configuration
#
# Copyright (c) 2018 Daniel Agar
#
# SPDX-License-Identifier: Apache-2.0
#

config BOARD_PX4_FMU_V5
	bool "PX4 FMU v5"
	depends on SOC_STM32F765XX
```

## boards/arm/px4_fmu_v5/Kconfig.defconfig
```kconfig
# Kconfig - PX4_FMU_V5 board configuration
#
# Copyright (c) 2018 Daniel Agar
#
# SPDX-License-Identifier: Apache-2.0
#

if BOARD_PX4_FMU_V5

config BOARD
	default "px4_fmu_v5"

if UART_CONSOLE

config UART_1
	default y

endif # UART_CONSOLE

if SERIAL

config UART_6
	default y

endif # SERIAL

if I2C

config I2C_1
	default y

endif # I2C

if SPI

config SPI_STM32_INTERRUPT
	default y

config SPI_2
	default y

endif # SPI

endif # BOARD_PX4_FMU_V5
```
